## config/boards/shields/Kconfig.shield
```kconfig
# Copyright (c) 2020 The ZMK Contributors
# SPDX-License-Identifier: MIT

config SHIELD_TRYING
    def_bool $(shields_list_contains,trying)
```

## config/boards/shields/trying/Kconfig.defconfig
```kconfig
# Copyright (c) 2020 The ZMK Contributors
# SPDX-License-Identifier: MIT

if SHIELD_TRYING

config ZMK_KEYBOARD_NAME
    default "Trying"

endif
```
